VERSION ""

NS_ :

BS_:

BU_: doorsECU BCM_ECU TMEP_ECU
VAL_TABLE_ ecu_status 1 "ECU on" 0 "ECU off" ;
VAL_TABLE_ tempModificationDirection 2 "decrease temp" 1 "increase temp" 0 "doNothing" ;
VAL_TABLE_ tempStatusIndicator_VT 2 "Hight Temperature (temp >= 100)" 1 "Low Temperature  (temp <= 40)" 0 "Normal Temperature (40>temp<100)" ;

BO_ 1280 controlDoors: 2 Vector__XXX
 SG_ childModeActivate : 8|1@1+ (1,0) [0|0] "" Vector__XXX
 SG_ activateDoorLocl : 0|1@1+ (1,0) [0|0] "" Vector__XXX

BO_ 0 doorsStatus: 1 doorsECU
 SG_ lockStaus : 1|1@1+ (1,0) [0|0] "" Vector__XXX
 SG_ childModeStatus : 0|1@1+ (1,0) [0|0] "" Vector__XXX

BO_ 768 ControlNetworlNode: 1 BCM_ECU
 SG_ doorEcuControl : 1|1@1+ (1,0) [0|1] "" Vector__XXX
 SG_ tempEcuControl : 0|1@1+ (1,0) [0|1] "" Vector__XXX

BO_ 512 ControlTemp: 2 BCM_ECU
 SG_ tempModificationDirection : 8|2@1+ (1,0) [0|0] "" Vector__XXX
 SG_ modifiedTempDegree : 0|8@1+ (1,0) [0|0] "" Vector__XXX

BO_ 256 temperatureStatus: 2 TMEP_ECU
 SG_ tempStatusIndicator : 8|2@1+ (1,0) [0|0] "" Vector__XXX
 SG_ tempDegree : 0|8@1+ (1,0) [0|255] "celsius" Vector__XXX

BA_DEF_ BO_  "CANFD_BRS" ENUM  "0","1";
BA_DEF_  "DBName" STRING ;
BA_DEF_  "BusType" STRING ;
BA_DEF_ BO_  "VFrameFormat" ENUM  "StandardCAN","ExtendedCAN","reserved","reserved","reserved","reserved","reserved","reserved","reserved","reserved","reserved","reserved","reserved","reserved","StandardCAN_FD","ExtendedCAN_FD";
BA_DEF_DEF_  "CANFD_BRS" "1";
BA_DEF_DEF_  "DBName" "";
BA_DEF_DEF_  "BusType" "";
BA_DEF_DEF_  "VFrameFormat" "StandardCAN";
BA_ "BusType" "CAN FD";
BA_ "DBName" "CAN_FD";
VAL_ 512 tempModificationDirection 2 "decrease temp" 1 "increase temp" 0 "doNothing" ;
VAL_ 256 tempStatusIndicator 2 "Hight Temp (temp > 100)" 1 "Low Temp (temp < 40)" 0 "Normal Temp(40>=temp<=100)" ;
